## cfw/Config.in
```kconfig
menu "R36S CFW packages"
source "$BR2_EXTERNAL_R36S_CFW_PATH/package/r36s-gpu-probe/Config.in"
endmenu
```

## cfw/config/buildroot-r36s-mesa_defconfig
```kconfig
BR2_aarch64=y
BR2_cortex_a35=y

BR2_TOOLCHAIN_EXTERNAL=y
BR2_TOOLCHAIN_EXTERNAL_BOOTLIN=y
BR2_TOOLCHAIN_EXTERNAL_BOOTLIN_AARCH64_GLIBC_STABLE=y
BR2_CCACHE=y

BR2_TARGET_GENERIC_HOSTNAME="r36s"
BR2_TARGET_GENERIC_ISSUE="R36S CFW Mesa/Panfrost bring-up"
BR2_TARGET_ENABLE_ROOT_LOGIN=y
BR2_TARGET_GENERIC_ROOT_PASSWD=""
BR2_INIT_BUSYBOX=y
BR2_ROOTFS_DEVICE_CREATION_DYNAMIC_MDEV=y
BR2_SYSTEM_BIN_SH_BUSYBOX=y
BR2_TARGET_GENERIC_GETTY=y
BR2_TARGET_GENERIC_GETTY_PORT="tty1"
BR2_TARGET_GENERIC_GETTY_BAUDRATE_KEEP=y

BR2_ROOTFS_OVERLAY="$(BR2_EXTERNAL_R36S_CFW_PATH)/rootfs-overlay"
BR2_ROOTFS_POST_BUILD_SCRIPT="$(BR2_EXTERNAL_R36S_CFW_PATH)/scripts/post-build-rootfs.sh"

BR2_PACKAGE_BUSYBOX_SHOW_OTHERS=y
BR2_PACKAGE_KMOD=y
BR2_PACKAGE_KMOD_TOOLS=y
BR2_PACKAGE_EVTEST=y
BR2_PACKAGE_I2C_TOOLS=y
BR2_PACKAGE_LIBDRM=y
BR2_PACKAGE_LIBDRM_INSTALL_TESTS=y

BR2_PACKAGE_MESA3D=y
BR2_PACKAGE_MESA3D_GALLIUM_DRIVER_PANFROST=y
BR2_PACKAGE_MESA3D_OPENGL_EGL=y
BR2_PACKAGE_MESA3D_OPENGL_ES=y
BR2_PACKAGE_MESA3D_GBM=y
BR2_PACKAGE_MESA3D_DEMOS=y
BR2_PACKAGE_KMSCUBE=y
BR2_PACKAGE_R36S_GPU_PROBE=y

BR2_TARGET_ROOTFS_EXT2=y
BR2_TARGET_ROOTFS_EXT2_4=y
BR2_TARGET_ROOTFS_EXT2_LABEL="ROOTFS"
BR2_TARGET_ROOTFS_EXT2_SIZE="256M"
BR2_TARGET_ROOTFS_EXT2_MKFS_OPTIONS="-O ^64bit"
# BR2_TARGET_ROOTFS_TAR is not set
```

## cfw/package/r36s-gpu-probe/Config.in
```kconfig
config BR2_PACKAGE_R36S_GPU_PROBE
	bool "r36s-gpu-probe"
	depends on BR2_PACKAGE_HAS_LIBEGL
	depends on BR2_PACKAGE_HAS_LIBGBM
	depends on BR2_PACKAGE_HAS_LIBGLES
	depends on BR2_TOOLCHAIN_HAS_THREADS
	select BR2_PACKAGE_LIBDRM
	help
	  Minimal direct DRM/GBM/EGL/GLES probe for R36S CFW bring-up.
	  It reports the active renderer and fails on software renderers.
```
